// Keypad - Version: Latest 
#include <Key.h>
#include <Keypad.h>

const byte ROWS = 4; // Four rows
const byte COLS = 3; // Three columns

enum Mode 
{
  Controller = 1,
  Function = 2,
  SetAddress = 3,
};

const Mode Modes[] {Controller, Function, SetAddress};

int currentMode;

String inputAddress = "";

String currentAddress = "";

// Define the Keymap
char keys[ROWS][COLS] = {
  {'1','2','3'},
  {'4','5','6'},
  {'7','8','9'},
  {'*','0','#'}
};
// Connect keypad ROW0, ROW1, ROW2 and ROW3 to these Arduino pins.
byte rowPins[ROWS] = { 3, 8, 7, 5 };
// Connect keypad COL0, COL1 and COL2 to these Arduino pins.
byte colPins[COLS] = { 4, 2, 6 }; 

// Create the Keypad
Keypad kpd = Keypad( makeKeymap(keys), rowPins, colPins, ROWS, COLS );

const int ledpin = 13;


void setup()
{
  pinMode(ledpin,OUTPUT);
  digitalWrite(ledpin, HIGH);
  Serial.begin(9600);
  currentMode = Modes[0];
  PrintMode();
}

void loop()
{
  char key = kpd.getKey();
  if(key)  // Check for a valid key.
  {
/*    Serial.print("K: ");
    Serial.println(key);*/
    switch (key)
    {
      case '*':
      // Serial.println(sizeof(Modes) / 2);
      if(currentMode <= sizeof(Modes) / 2 - 1)
      {
        currentMode += 1;
      }
      else
      {
        currentMode = 1;
      }
      PrintMode();
        break;
      case '#':
      if(currentMode == Controller)
      {
        currentAddress = inputAddress;
        inputAddress = "";
        Serial.println(currentAddress);
      }
        break;
      default:
      inputAddress += key;
      // Serial.println(inputAddress);
    }
}
}
void PrintMode()
{
  //Serial.println(currentMode);
  switch (currentMode)
    {
      case Controller:
      Serial.println("Controller");
      break;
      case Function:
      Serial.println("Function");
      break;
      case SetAddress:
      Serial.println("Set Address");
      break;
    }
}
    
  

